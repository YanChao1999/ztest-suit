## fixtures/sample-west/tests/math/testcase.yaml
```yaml
tests:
  ztest_suit.math:
    tags:
      - ztest_suit
      - math
    platform_allow:
      - native_sim
    integration_platforms:
      - native_sim
```

## fixtures/sample-west/tests/string/testcase.yaml
```yaml
tests:
  ztest_suit.string:
    tags:
      - ztest_suit
      - string
    platform_allow:
      - native_sim
    integration_platforms:
      - native_sim
```
